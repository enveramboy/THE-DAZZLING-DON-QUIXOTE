#include <Arduino.h>
#include <Servo.h>
#include <SPI.h>
#include <Adafruit_GFX.h>
#include <Adafruit_SSD1306.h>
#include <Ps3Controller.h>
#include <Ramp.h>

/*
  LED VARIABLES
*/

#define chest 25

enum Chest_State {
  IDLE,
  CLOSED,
  FOCUSED
};

enum Chest_State chest_state = IDLE;

/*
  SERVO VARIABLES
*/

#define r_shoulder 0
#define r_deltoid 1
#define r_bicep 2

#define l_shoulder 3
#define l_deltoid 4
#define l_bicep 5

#define waist 6

#define r_hip 7
#define r_foot 8

#define l_hip 9
#define l_foot 10

int servo_pins[] = { 15, 2, 4, 5, 18, 19, 13, 12, 14, 26, 27 };

Servo s_r_shoulder;
Servo s_r_deltoid;
Servo s_r_bicep;

Servo s_l_shoulder;
Servo s_l_deltoid;
Servo s_l_bicep;

Servo s_waist;

Servo s_r_hip;
Servo s_r_foot;

Servo s_l_hip;
Servo s_l_foot;

Servo servos[] = { 
  s_r_shoulder, s_r_deltoid, s_r_bicep, 
  s_l_shoulder, s_l_deltoid, s_l_bicep, 
  s_waist,
  s_r_hip, s_r_foot,
  s_l_hip, s_l_foot
};

int std_pos[] = {70, 0, 120, 100, 180, 65, 100, 75, 75, 105, 105};
int gaucho_pos[] = {70, 0, 120, 100, 180, 65, 100, 90, 90, 90, 90};
int crouch_pos[] = {70, 0, 120, 100, 180, 65, 100, 155, 155, 25, 25};

/*
  BATTERY MONITORING VARIABLES
*/

#define battery 35
#define K 100

float readings[K];
int reading_idx = 0;

const unsigned char full_charge [] PROGMEM = {
	0x00, 0x00, 0x00, 0x00, 0x00, 0x00, 0x00, 0x00, 0x00, 0x00, 0x00, 0x00, 0x00, 0x00, 0x00, 0x00, 
	0x00, 0x00, 0x00, 0x00, 0x00, 0x00, 0x00, 0x00, 0x00, 0x00, 0x00, 0x00, 0x00, 0x00, 0x00, 0x00, 
	0x00, 0x00, 0x00, 0x00, 0x00, 0x00, 0x00, 0x00, 0x00, 0x00, 0x00, 0x00, 0x00, 0x00, 0x00, 0x00, 
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	0x00, 0x00, 0x00, 0x00, 0x00, 0x00, 0x00, 0x00, 0x00, 0x00, 0x00, 0x00, 0x00, 0x00, 0x00, 0x00
};

const unsigned char two_bar_charge [] PROGMEM = {
	0x00, 0x00, 0x00, 0x00, 0x00, 0x00, 0x00, 0x00, 0x00, 0x00, 0x00, 0x00, 0x00, 0x00, 0x00, 0x00, 
	0x00, 0x00, 0x00, 0x00, 0x00, 0x00, 0x00, 0x00, 0x00, 0x00, 0x00, 0x00, 0x00, 0x00, 0x00, 0x00, 
	0x00, 0x00, 0x00, 0x00, 0x00, 0x00, 0x00, 0x00, 0x00, 0x00, 0x00, 0x00, 0x00, 0x00, 0x00, 0x00, 
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	0x00, 0x00, 0x00, 0x00, 0x00, 0x00, 0x00, 0x00, 0x00, 0x00, 0x00, 0x00, 0x00, 0x00, 0x00, 0x00
};

const unsigned char one_bar_charge [] PROGMEM = {
	0x00, 0x00, 0x00, 0x00, 0x00, 0x00, 0x00, 0x00, 0x00, 0x00, 0x00, 0x00, 0x00, 0x00, 0x00, 0x00, 
	0x00, 0x00, 0x00, 0x00, 0x00, 0x00, 0x00, 0x00, 0x00, 0x00, 0x00, 0x00, 0x00, 0x00, 0x00, 0x00, 
	0x00, 0x00, 0x00, 0x00, 0x00, 0x00, 0x00, 0x00, 0x00, 0x00, 0x00, 0x00, 0x00, 0x00, 0x00, 0x00, 
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	0x00, 0x00, 0x00, 0x00, 0x00, 0x00, 0x00, 0x00, 0x00, 0x00, 0x00, 0x00, 0x00, 0x00, 0x00, 0x00
};

const unsigned char empty_charge [] PROGMEM = {
	0x00, 0x00, 0x00, 0x00, 0x00, 0x00, 0x00, 0x00, 0x00, 0x00, 0x00, 0x00, 0x00, 0x00, 0x00, 0x00, 
	0x00, 0x00, 0x00, 0x00, 0x00, 0x00, 0x00, 0x00, 0x00, 0x00, 0x00, 0x00, 0x00, 0x00, 0x00, 0x00, 
	0x00, 0x00, 0x00, 0x00, 0x00, 0x00, 0x00, 0x00, 0x00, 0x00, 0x00, 0x00, 0x00, 0x00, 0x00, 0x00, 
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	0x00, 0x00, 0x00, 0x00, 0x00, 0x00, 0x00, 0x00, 0x00, 0x00, 0x00, 0x00, 0x00, 0x00, 0x00, 0x00
};

Adafruit_SSD1306 lcd(128, 64, &Wire, -1);

// Battery Display Function
void Display_Voltage() {
  readings[reading_idx] = analogRead(battery);
  float voltage = 0;
  for (int i = 0; i < K; i++) voltage += readings[i];
  voltage /= K;

  lcd.clearDisplay();

  if (voltage >= 3050) lcd.drawBitmap(0, 0, full_charge, 128, 64, 1);
  else if (voltage >= 2800) lcd.drawBitmap(0, 0, two_bar_charge, 128, 64, 1);
  else if (voltage >= 2550) {
    if (millis() % 2000 < 1000) lcd.drawBitmap(0, 0, one_bar_charge, 128, 64, 1);
  }
  else {
    if (millis() % 2000 < 1000) lcd.drawBitmap(0, 0, empty_charge, 128, 64, 1);
  }

  lcd.display();

  reading_idx = (reading_idx + 1) % K;
}

void Waiting_To_Pair(int phase) {
	lcd.clearDisplay();
	lcd.setCursor(0, 54);
	switch (phase) {
		case 0:
			lcd.print("Waiting to pair");
			break;
		case 1:
			lcd.print("Waiting to pair.");
			break;
		case 2:
			lcd.print("Waiting to pair..");
			break;
		case 3:
			lcd.print("Waiting to pair...");
			break;
	}
	lcd.display();
}

/*
  ANIMATION FUNCTIONS
*/
bool crouched = false;

// Locomotion
void Left(int spd) {
  unsigned long delta = millis() % spd;
  if (delta < spd/2) {
    // Raise Body and Reorient
    s_l_foot.write(gaucho_pos[l_foot]-20);
    s_r_foot.write(gaucho_pos[r_foot]+20);
    s_waist.write(gaucho_pos[waist]);
  }
  else {
    // Lower Body and Turn Left
    s_l_foot.write(gaucho_pos[l_foot]);
    s_r_foot.write(gaucho_pos[r_foot]);
    s_waist.write(gaucho_pos[waist]+80);
  }

  // Fix Rest of Body
  for (int i = 0; i < 11; i++) {
    if (i != l_foot && i != r_foot && i != waist) servos[i].write(gaucho_pos[i]);
  }
}

void Right(int spd) {
  unsigned long delta = millis() % spd;
  if (delta < spd/2) {
    // Raise Body and Reorient
    s_l_foot.write(gaucho_pos[l_foot]-20);
    s_r_foot.write(gaucho_pos[r_foot]+20);
    s_waist.write(gaucho_pos[waist]);
  }
  else {
    // Lower Body and Turn Right
    s_l_foot.write(gaucho_pos[l_foot]);
    s_r_foot.write(gaucho_pos[r_foot]);
    s_waist.write(gaucho_pos[waist]-80);
  }

  // Fix Rest of Body
  for (int i = 0; i < 11; i++) {
    if (i != l_foot && i != r_foot && i != waist) servos[i].write(gaucho_pos[i]);
  }
}

void Sidestep_Left(int spd) {
  unsigned long delta = millis() % spd;
  if (delta < spd/2) {
    // Thrust
    s_r_hip.write(std_pos[r_hip]+20);
    s_r_foot.write(std_pos[r_foot]-20);
    // Catch
    s_l_hip.write(std_pos[l_hip]-20);
    s_l_foot.write(std_pos[l_foot]-20);
  }
  else {
    // Reset
    s_l_hip.write(std_pos[l_hip]);
    s_l_foot.write(std_pos[l_foot]);
    s_r_hip.write(std_pos[r_hip]);
    s_r_foot.write(std_pos[r_foot]);
  }

  // Fix Rest of Body
  for (int i = 0; i < 11; i++) {
    if (i != r_hip && i != r_foot && i != l_hip && i != l_foot) servos[i].write(std_pos[i]);
  }
}

void Sidestep_Right(int spd) {
  unsigned long delta = millis() % spd;
  if (delta < spd/2) {
    // Thrust
    s_l_hip.write(std_pos[l_hip]-20);
    s_l_foot.write(std_pos[l_foot]+20);
    // Catch
    s_r_hip.write(std_pos[r_hip]+20);
    s_r_foot.write(std_pos[r_foot]+20);
  }
  else {
    // Reset
    s_l_hip.write(std_pos[l_hip]);
    s_l_foot.write(std_pos[l_foot]);
    s_r_hip.write(std_pos[r_hip]);
    s_r_foot.write(std_pos[r_foot]);
  }

  // Fix Rest of Body
  for (int i = 0; i < 11; i++) {
    if (i != r_hip && i != r_foot && i != l_hip && i != l_foot) servos[i].write(std_pos[i]);
  }
}

void Forward(int spd) {
  unsigned long delta = millis() % spd;

  if (delta < spd/2) {
    // Shift Mass Left and Rotate Left
    s_l_foot.write(std_pos[l_foot]+25);
    s_r_foot.write(std_pos[r_foot]+25);
    s_waist.write(std_pos[waist]+45);
  }
  else {
    // Shift Mass Right and Rotate Right
    s_l_foot.write(std_pos[l_foot]-25);
    s_r_foot.write(std_pos[r_foot]-25);
    s_waist.write(std_pos[waist]-45);
  }

  // Fix Rest of Body
  for (int i = 0; i < 11; i++) {
    if (i != r_foot && i != l_foot && i != waist) servos[i].write(std_pos[i]);
  }
}

void Backward(int spd) {
  unsigned long delta = millis() % spd;

  if (delta < spd/2) {
    // Shift Mass Left and Rotate Left
    s_l_foot.write(std_pos[l_foot]+25);
    s_r_foot.write(std_pos[r_foot]+25);
    s_waist.write(std_pos[waist]-45);
  }
  else {
    // Shift Mass Right and Rotate Right
    s_l_foot.write(std_pos[l_foot]-25);
    s_r_foot.write(std_pos[r_foot]-25);
    s_waist.write(std_pos[waist]+45);
  }

  // Fix Rest of Body
  for (int i = 0; i < 11; i++) {
    if (i != r_foot && i != l_foot && i != waist) servos[i].write(std_pos[i]);
  }
}

// Attacks
void Right_Jab() {
	s_waist.write(std_pos[waist]+55);
	s_r_bicep.write(std_pos[r_bicep]-120);
	s_r_shoulder.write(std_pos[r_shoulder]+100);
	s_r_deltoid.write(std_pos[r_deltoid]+35);

	if (crouched) {
		for (int i = 7; i < 11; i++) servos[i].write(crouch_pos[i]);
	}
	else {
		for (int i = 7; i < 11; i++) servos[i].write(gaucho_pos[i]);
	}
}

void Left_Jab() {
	s_waist.write(std_pos[waist]-55);
	s_l_bicep.write(std_pos[l_bicep]+115);
	s_l_shoulder.write(std_pos[l_shoulder]-100);
	s_l_deltoid.write(std_pos[l_deltoid]-35);

	if (crouched) {
		for (int i = 7; i < 11; i++) servos[i].write(crouch_pos[i]);
	}
	else {
		for (int i = 7; i < 11; i++) servos[i].write(gaucho_pos[i]);
	}
}

void Right_Sweep() {
	s_r_deltoid.write(std_pos[r_deltoid]+90);
	s_l_deltoid.write(std_pos[l_deltoid]-90);
	s_r_bicep.write(std_pos[r_bicep]-120);
	s_l_bicep.write(std_pos[l_bicep]+115);
	s_waist.write(std_pos[waist]+80);

	if (crouched) {
		for (int i = 7; i < 11; i++) servos[i].write(crouch_pos[i]);
	}
	else {
		for (int i = 7; i < 11; i++) servos[i].write(gaucho_pos[i]);
	}
}

void Left_Sweep() {
	s_r_deltoid.write(std_pos[r_deltoid]+90);
	s_l_deltoid.write(std_pos[l_deltoid]-90);
	s_r_bicep.write(std_pos[r_bicep]-120);
	s_l_bicep.write(std_pos[l_bicep]+115);
	s_waist.write(std_pos[waist]-80);

	if (crouched) {
		for (int i = 7; i < 11; i++) servos[i].write(crouch_pos[i]);
	}
	else {
		for (int i = 7; i < 11; i++) servos[i].write(gaucho_pos[i]);
	}
}

void Dragon_Push() {
	s_l_bicep.write(std_pos[l_bicep]+115);
	s_l_shoulder.write(std_pos[l_shoulder]-100);
	s_r_bicep.write(std_pos[r_bicep]-120);
	s_r_shoulder.write(std_pos[r_shoulder]+100);

	if (crouched) {
		for (int i = 6; i < 11; i++) servos[i].write(crouch_pos[i]);
	}
	else {
		for (int i = 6; i < 11; i++) servos[i].write(gaucho_pos[i]);
	}
}

unsigned long r_trigger_timeout = 0;
unsigned long l_trigger_timeout = 0;

void Right_Hook() {
	if (millis() < r_trigger_timeout + 500) {
		// Orient
		s_r_bicep.write(std_pos[r_bicep]-105);
		s_r_shoulder.write(std_pos[r_shoulder]);
		s_waist.write(std_pos[waist]);
	}
	else {
		// Thrust
		s_r_bicep.write(std_pos[r_bicep]-105);
		s_r_shoulder.write(std_pos[r_shoulder]+110);
		s_waist.write(std_pos[waist]+35);
	}

	// Fix Rest of Body
  	for (int i = 0; i < 11; i++) {
    	if (i != r_bicep && i != r_shoulder && i != waist) servos[i].write(gaucho_pos[i]);
  	}
}

void Left_Hook() {
	if (millis() < l_trigger_timeout + 500) {
		// Orient
		s_l_bicep.write(std_pos[l_bicep]+105);
		s_l_shoulder.write(std_pos[l_shoulder]);
		s_waist.write(std_pos[waist]);
	}
	else {
		// Thrust
		s_l_bicep.write(std_pos[l_bicep]+105);
		s_l_shoulder.write(std_pos[l_shoulder]-100);
		s_waist.write(std_pos[waist]-35);
	}

	// Fix Rest of Body 
  	for (int i = 0; i < 11; i++) {
    	if (i != l_bicep && i != l_shoulder && i != waist) servos[i].write(gaucho_pos[i]);
  	}
}

// Taunts
rampInt t1_r_bicep;

rampInt t2_r_bicep;
rampInt t2_l_bicep;

rampInt t3_l_bicep;


void Bring_It_On() {
	s_r_bicep.write(t1_r_bicep.update());
	s_r_shoulder.write(std_pos[r_shoulder]+90);

	// Fix Rest of Body
  	for (int i = 0; i < 11; i++) {
    	if (i != r_bicep && i != r_shoulder) servos[i].write(gaucho_pos[i]);
  	}
}

void Flex() {
	s_r_bicep.write(t2_r_bicep.update());
	s_l_bicep.write(t2_l_bicep.update());

	s_r_shoulder.write(std_pos[r_shoulder]+90);
	s_l_shoulder.write(std_pos[l_shoulder]-100);
	s_r_deltoid.write(std_pos[r_deltoid]+90);
	s_l_deltoid.write(std_pos[l_deltoid]-90);

	// Fix Rest of Body
	for (int i = 6; i < 11; i++) {
    	servos[i].write(gaucho_pos[i]);
  	}
}

void Grand_Battle() {
	// s_l_bicep.write(std_pos[l_bicep] + t3_l_bicep.update());
	s_l_bicep.write(t3_l_bicep.update());
	s_r_bicep.write(std_pos[r_bicep]);

	s_waist.write(std_pos[waist]-100);
	s_r_deltoid.write(std_pos[r_deltoid]+90);
	s_r_shoulder.write(std_pos[r_shoulder]+90);
	s_l_shoulder.write(std_pos[l_shoulder]-100);
	s_l_deltoid.write(std_pos[l_deltoid]-90);

	// Fix Rest of Body
	for (int i = 7; i < 11; i++) {
    	servos[i].write(gaucho_pos[i]);
  	}
}

void Revel() {
	s_r_shoulder.write(std_pos[r_shoulder]+30);
	s_l_shoulder.write(std_pos[l_shoulder]-30);
	s_r_deltoid.write(std_pos[r_deltoid]+90);
	s_l_deltoid.write(std_pos[l_deltoid]-90);
	s_r_bicep.write(std_pos[r_bicep]-120);
	s_l_bicep.write(std_pos[l_bicep]+115);

	// Fix Rest of Body
	for (int i = 6; i < 11; i++) {
    	servos[i].write(gaucho_pos[i]);
  	}
}

void Idle() {
	if (crouched) {
		for (int i = 0; i < 11; i++) servos[i].write(crouch_pos[i]);
	}
	else {
		for (int i = 0; i < 11; i++) servos[i].write(gaucho_pos[i]);
	}
}

// LED Animations
void Idle_Chest() { analogWrite(chest, 255); }

void Close_Chest() { analogWrite(chest, 0); }

void Focus_Chest() { analogWrite(chest, 170); }

/*
	PS3 CALLBACKS
*/

void notify() {
	ps3_button_t btn_down = Ps3.data.button;
  	ps3_analog_stick_t stick_data = Ps3.data.analog.stick;
  	int lx = stick_data.lx;
  	int ly = stick_data.ly;
  	int rx = stick_data.rx;
  	int ry = stick_data.ry;

	// Update timestamps on initial button click
	if (Ps3.event.button_down.r1) r_trigger_timeout = millis();
	if (Ps3.event.button_down.l1) l_trigger_timeout = millis();
	if (Ps3.event.button_down.cross) crouched = !crouched;

  	// Check if battery is low
  	float voltage = 0;
  	for (int i = 0; i < K; i++) voltage += readings[i];
  	voltage /= K;
  	if (voltage < 2550) { 
    	chest_state = CLOSED;
    	Idle(); 
  	}
	// Check if any buttons are pressed
	else if (
		btn_down.up || btn_down.right || btn_down.down || btn_down.left || 
		btn_down.triangle || btn_down.circle || btn_down.cross || btn_down.square ||
		btn_down.l2 || btn_down.l1 || btn_down.r2 || btn_down.r1
	) {
		chest_state = FOCUSED;
		if (btn_down.up) Bring_It_On();
		if (btn_down.right) Flex();
		if (btn_down.down) Grand_Battle();
		if (btn_down.left) Revel();
		if (btn_down.triangle) Dragon_Push();
		if (btn_down.circle) Right_Jab();
		if (btn_down.square) Left_Jab();
		if (!crouched) {
			if (btn_down.l1) Left_Hook();
			if (btn_down.r1) Right_Hook();
		}
		if (btn_down.l2) Left_Sweep();
		if (btn_down.r2) Right_Sweep();
	}
	// Else check if the stick movement is above a certain threshold
  	else if (abs(lx) > 10 || abs(ly) > 10 || abs(rx) > 10 || abs(ry) > 10) {
    	chest_state = FOCUSED;

    	// Check which stick received the stronger signal
    	if (abs(ry) + abs(rx) < abs(ly) + abs(lx)) {
      		if (abs(ly) > abs(lx)) {
        		if (ly < 0) Forward(350);
        		else Backward(350);
      	}
      	else {
        	if (lx < 0) Right(350);
        	else Left(350);
      	}
    	}
    	else {
      		if (rx < 0) Sidestep_Left(250);
      		else Sidestep_Right(250);
    	}
  	}
  	// No input, idle
  	else {
    	chest_state = IDLE; 
    	Idle();
  }
}

void On_Connect() {
	lcd.setRotation(0);
	Ps3.setPlayer(1);
	chest_state = IDLE;
	Idle();
}

void setup() {
	// Chest Initialization
	pinMode(chest, OUTPUT);

	// Servo Initialization
	for (int i = 0; i < 11; i++) servos[i].attach(servo_pins[i]);

	// Battery Monitoring Initialization
	lcd.begin(SSD1306_SWITCHCAPVCC, 0x3C);
	lcd.clearDisplay();
	pinMode(battery, INPUT);

	lcd.setRotation(1);
	lcd.setTextSize(1);
	lcd.setTextColor(SSD1306_WHITE);

	// Ps3 Initialization
	Ps3.attach(notify);
	Ps3.attachOnConnect(On_Connect);
	Ps3.begin("2c:81:58:3a:93:f7");

	// Animation Ramps Initialization
	t1_r_bicep.go(std_pos[r_bicep]);
	t1_r_bicep.go(std_pos[r_bicep]-35, 2500, LINEAR, FORTHANDBACK);	

	t2_r_bicep.go(std_pos[r_bicep]-45);
	t2_r_bicep.go(std_pos[r_bicep]-95, 2500, SINUSOIDAL_OUT, FORTHANDBACK);
	t2_l_bicep.go(std_pos[l_bicep]+45);
	t2_l_bicep.go(std_pos[l_bicep]+95, 2500, SINUSOIDAL_OUT, FORTHANDBACK);

	t3_l_bicep.go(std_pos[l_bicep]);
	t3_l_bicep.go(std_pos[l_bicep]+115, 2500, LINEAR, FORTHANDBACK);
}

void loop() {
	while (!Ps3.isConnected()) {
		for (int i = 0; i < 255; i++) {
			Waiting_To_Pair((i/17) % 4);
      		analogWrite(chest, i);
      		delay(10);
    	}
		for (int i = 255; i > 0; i--) {
			Waiting_To_Pair(((255-i)/17) % 4);
      		analogWrite(chest, i);
      		delay(10);
    	}
	}

	switch (chest_state) {
		case IDLE:
			Idle_Chest();
			break;
		case CLOSED:
			Close_Chest();
			break;
		case FOCUSED:
			Focus_Chest();
			break;
	}

	Display_Voltage();
}